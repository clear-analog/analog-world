## CMakeLists.txt
```
# SPDX-License-Identifier: Apache-2.0

cmake_minimum_required(VERSION 3.13.1)
set(BOARD esp32_devkitc/esp32/procpu)

find_package(Zephyr REQUIRED HINTS $ENV{ZEPHYR_BASE})
project(ads1299_acquisition LANGUAGES C)

# Add source files
target_sources(app PRIVATE
    src/main.c
    src/ads1299.c
    src/data_handler.c
)

# Add include directories
target_include_directories(app PRIVATE
    src/
)
```

## prj.conf
```kconfig
# Basic Zephyr Kernel
CONFIG_MAIN_STACK_SIZE=4096
CONFIG_HEAP_MEM_POOL_SIZE=4096

# Enable Printk and Console
CONFIG_PRINTK=y
CONFIG_SERIAL=y
CONFIG_CONSOLE=y
CONFIG_UART_CONSOLE=y
CONFIG_SPI=y

# --- ESP32 Specifics ---
# Ensure the console baud rate is what you expect (115200 is common for ESP32)
CONFIG_ESP32_USE_UNSUPPORTED_REVISION=y

# C Library for printf family functions
CONFIG_NEWLIB_LIBC=y

# If you were to print floats, you'd need this:
# CONFIG_NEWLIB_LIBC_FLOAT_PRINTF=y
```

## app.overlay
```dts
/{
};

&spi3 {
    status = "okay";
    cs-gpios = <&gpio0 5 GPIO_ACTIVE_LOW>;
    compatible = "espressif,esp32-spi";
};

&uart0 {
    status = "okay";
    current-speed = <921600>;
};
```

## src/main.c
```c
#include <zephyr/kernel.h>
#include <zephyr/device.h>
#include <zephyr/drivers/spi.h>
#include <zephyr/drivers/gpio.h>
#include <zephyr/sys/printk.h>
#include "ads1299.h"
//#include "data_handler.h"

// GPIO Pin definitions
#define ADS1299_PWDN_PIN    13
#define ADS1299_RST_PIN     12
#define ADS1299_START_PIN   14
#define ADS1299_DRDY_PIN    27

// Data buffer for ADS1299 samples
static uint8_t ads_raw_data[27]; // 24 bits status + 24*8 bits data = 216 bits = 27 bytes
//static ads1299_sample_t current_sample;

// USB/UART transmission buffer
static uint8_t tx_buffer[64];

// Forward declarations
static void drdy_interrupt_handler(const struct device *dev, struct gpio_callback *cb, uint32_t pins);
static int ads1299_init_device(const struct device *gpio_dev, const struct ads1299_config *ads1299_cfg);
static int ads1299_read_data(const struct ads1299_config *ads1299_cfg);
//static void data_acquisition_thread(const struct ads1299_config *ads1299_cfg);
//static void usb_transmission_thread(void);

/* // Thread definitions
K_THREAD_DEFINE(acq_thread, 2048, data_acquisition_thread, NULL, NULL, NULL, 
                K_PRIO_COOP(5), 0, 0);
 K_THREAD_DEFINE(usb_thread, 2048, usb_transmission_thread, NULL, NULL, NULL, 
                K_PRIO_COOP(7), 0, 0);

// Semaphores for thread synchronization
K_SEM_DEFINE(data_ready_sem, 0, 1); // this is DRDY pin part
K_SEM_DEFINE(usb_ready_sem, 0, 10);

static void drdy_interrupt_handler(const struct device *dev, struct gpio_callback *cb, uint32_t pins) {
    ARG_UNUSED(dev);
    ARG_UNUSED(cb);
    ARG_UNUSED(pins);
    
    data_ready = true;
    k_sem_give(&data_ready_sem);
} */

static int ads1299_init_device(const struct device *gpio_dev, const struct ads1299_config *ads1299_cfg) {
    int ret;

    printk("Initializing ADS1299...\n");

    // Power down sequence
    gpio_pin_set(gpio_dev, ADS1299_PWDN_PIN, 0);
    k_msleep(1);
    gpio_pin_set(gpio_dev, ADS1299_RST_PIN, 0);
    k_msleep(1);

    // Power up sequence
    gpio_pin_set(gpio_dev, ADS1299_PWDN_PIN, 1);
    k_msleep(10);
    gpio_pin_set(gpio_dev, ADS1299_RST_PIN, 1);
    k_msleep(100); // Wait for power-on reset

    printk("No issue with gpio manipulation\n");

    // Test: Check if SPI config is valid
    printk("SPI device: %p\n", ads1299_cfg->zephyr_spi_dev);
    printk("SPI config: %p\n", ads1299_cfg->spi_cfg);
    printk("CS GPIO port: %p\n", ads1299_cfg->spi_cfg->cs.gpio.port);
    printk("CS GPIO pin: %d\n", ads1299_cfg->spi_cfg->cs.gpio.pin);

    // COMMENT OUT THE CRASHING CALLS FOR NOW
    ADS1299_SDATAC(ads1299_cfg);
    printk("Skipped ADS1299_SDATAC for now\n");

    // ret = ADS1299_SETUP(ads1299_cfg);
    printk("Skipped ADS1299_SETUP for now\n");

    // ADS1299_RDATAC(ads1299_cfg);
    printk("Skipped ADS1299_RDATAC for now\n");

    printk("ADS1299 initialization complete\n");
    return 0;
}


/* static int ads1299_read_data(const struct ads1299_config *ads1299_cfg) {
    struct spi_buf rx_buf = {
        .buf = ads_raw_data,
        .len = sizeof(ads_raw_data)
    };
    struct spi_buf_set rx_bufs = {
        .buffers = &rx_buf,
        .count = 1
    };
    
    // Read data from ADS1299
    int ret = spi_read(ads1299_cfg->zephyr_spi_dev, ads1299_cfg->spi_cfg, &rx_bufs);
    if (ret != 0) {
        printk("SPI read failed: %d\n", ret);
        return ret;
    }
    
    return 0;
}

static void data_acquisition_thread(const struct ads1299_config *ads1299_cfg) {
    int ret;

    printk("Data acquisition thread started\n");

    while (1) {
        // Wait for DRDY interrupt
        k_sem_take(&data_ready_sem, K_FOREVER);

        if (!acquisition_active) {
            continue;
        }

        // Read data from ADS1299
        ret = ads1299_read_data(ads1299_cfg);
        if (ret == 0) {
            // Process raw data into structured format
            process_ads1299_data(ads_raw_data, &current_sample);

            // Signal USB thread that new data is ready
            k_sem_give(&usb_ready_sem);
        }

        data_ready = false;
        printk("I wuz here");
    }
} */

/*static void usb_transmission_thread(void) {
    int ret;
    size_t tx_len;
    
    printk("USB transmission thread started\n");
    
    while (1) {
        // Wait for new sample data
        k_sem_take(&usb_ready_sem, K_FOREVER);
        
        // Format data for transmission
        tx_len = format_sample_for_transmission(&current_sample, tx_buffer, sizeof(tx_buffer));
        
        if (tx_len > 0) {
            // Send data via UART (USB CDC)
            for (size_t i = 0; i < tx_len; i++) {
                uart_poll_out(uart_dev, tx_buffer[i]);
                printk("%d\n", tx_buffer[i]);
            }
        }
    }
} */

int main(void) {
    int ret;
    k_msleep(2000);
    printk("Basic Test Starting...\n");
    
    // Get device handles
    const struct device *uart_dev = DEVICE_DT_GET(DT_NODELABEL(uart0));
    if (!device_is_ready(uart_dev)) {
        printk("UART device not ready\n");
        return -1;
    }
    
    const struct device *gpio_dev = DEVICE_DT_GET(DT_NODELABEL(gpio0));
    if (!device_is_ready(gpio_dev)) {
        printk("GPIO device not ready\n");
        return -1;
    }

    // Configure all GPIO pins
    ret = gpio_pin_configure(gpio_dev, ADS1299_PWDN_PIN, GPIO_OUTPUT_INACTIVE);
    if (ret != 0) {
        printk("Failed to configure PWDN pin: %d\n", ret);
        return ret;
    }
    
    ret = gpio_pin_configure(gpio_dev, ADS1299_RST_PIN, GPIO_OUTPUT_INACTIVE);
    if (ret != 0) {
        printk("Failed to configure RST pin: %d\n", ret);
        return ret;
    }
    
    ret = gpio_pin_configure(gpio_dev, ADS1299_START_PIN, GPIO_OUTPUT_INACTIVE);
    if (ret != 0) {
        printk("Failed to configure START pin: %d\n", ret);
        return ret;
    }
    
    ret = gpio_pin_configure(gpio_dev, ADS1299_DRDY_PIN, GPIO_INPUT | GPIO_INT_EDGE_FALLING);
    if (ret != 0) {
        printk("Failed to configure DRDY pin: %d\n", ret);
        return ret;
    }
    
    printk("All GPIO pins configured successfully\n");

    //const struct gpio_dt_spec cs_gpio = GPIO_DT_SPEC_GET_BY_IDX(DT_NODELABEL(spi3), cs_gpios, 0);
    
    const struct gpio_dt_spec cs_gpio = {
    .port = DEVICE_DT_GET(DT_NODELABEL(gpio0)),
    .pin = 5,
    .dt_flags = GPIO_ACTIVE_LOW
};
    printk("Got CS_GPIO no prob\n");
    struct spi_config ads1299_spi_cfg = {
        .frequency = 4000000,
        .operation = SPI_WORD_SET(8) | SPI_TRANSFER_MSB | SPI_MODE_CPHA | SPI_OP_MODE_MASTER,
        //.slave = 0,
        .cs = {
            .gpio = &cs_gpio,
            .delay = 1
        }
    };
    const struct device *spi_zephyr_dev = DEVICE_DT_GET(DT_NODELABEL(spi3));
    printk("Got the SPI ZEPHYR DEVICE no prob");
    if (!device_is_ready(spi_zephyr_dev)) {
        printk("SPI device not ready\n");
        return -1;
    }

/*     // With this:
    struct ads1299_config ads1299_config = {
        .zephyr_spi_dev = spi_zephyr_dev,  // Note: no & needed since spi_zephyr_dev is already a pointer
        .spi_cfg = &ads1299_spi_cfg
    }; */

    struct ads1299_config ads1299_cfg = {
        .zephyr_spi_dev = spi_zephyr_dev,
        .spi_cfg = &ads1299_spi_cfg
    };

    printk("SPI device ready\n");
    ret = ADS1299_INIT(&ads1299_cfg);
    printk("ADS1299 Driver Init done");

    // Initialize ADS1299
    ret = ads1299_init_device(gpio_dev, &ads1299_cfg);
    if (ret != 0) {
        printk("Failed to initialize ADS1299: %d\n", ret);
        return ret;
    }
    
/*     // Setup DRDY interrupt
    gpio_init_callback(&drdy_cb_data, drdy_interrupt_handler, BIT(ADS1299_DRDY_PIN));
    ret = gpio_add_callback(gpio_dev, &drdy_cb_data);
    if (ret != 0) {
        printk("Failed to add GPIO callback: %d\n", ret);
        return ret;
    }
    
    ret = gpio_pin_interrupt_configure(gpio_dev, ADS1299_DRDY_PIN, GPIO_INT_EDGE_FALLING);
    if (ret != 0) {
        printk("Failed to configure GPIO interrupt: %d\n", ret);
        return ret;
    }

    printk("Interrupt configured\n"); */

    // Main loop
    while (1) {
        k_msleep(1000);
        printk("System running...\n");
        printk(ADS1299_SEND_CMD(0x00, &ads1299_cfg));
    }
    
    return 0;    
    /*
    // Setup DRDY interrupt
    gpio_init_callback(&drdy_cb_data, drdy_interrupt_handler, BIT(ADS1299_DRDY_PIN));
    ret = gpio_add_callback(gpio_dev, &drdy_cb_data);
    if (ret != 0) {
        printk("Failed to add GPIO callback: %d\n", ret);
        return ret;
    }
    
    ret = gpio_pin_interrupt_configure(gpio_dev, ADS1299_DRDY_PIN, GPIO_INT_EDGE_FALLING);
    if (ret != 0) {
        printk("Failed to configure GPIO interrupt: %d\n", ret);
        return ret;
    }

    struct ads1299_config ads_config = {
        .spi_zephyr_dev = spi_zephyr_dev,
        .spi_cfg = &ads1299_spi_cfg
    };
    
    ret = ads1299_init(&ads_config);
    if (ret != 0) {
        printk("Failed to initialize ADS1299 driver: %d\n", ret);
        return ret;
    }
    

    
    printk("System initialized successfully. Starting data acquisition...\n");
    
    // Main loop - can be used for status monitoring or commands
    while (1) {
        k_msleep(1000);
        printk("Cool world\n");
        // Could add status printing, command processing, etc.
    }
    */
}
```

## src/ads1299.c
```c
#include "ads1299.h"
#include <zephyr/kernel.h>
#include <zephyr/device.h>
#include <zephyr/drivers/spi.h>
#include <zephyr/sys/printk.h>

/* List of registers to be set. If -2, end WREG. */
const regVal_pair ADS1299_REGISTER_LS[] = {
    {0x01, 0b10110000},  // CONFIG1: Data rate 250 SPS
    {0x02, 0b11010000},  // CONFIG2: Internal test signal enabled
    {0x03, 0b11101100},  // CONFIG3: Reference buffer enabled, bias enabled
    {0x04, 0},           // LOFF: Lead-off detection disabled
    {-2, -2},            // End of first section
    {0x05, 0b01100000},  // CH1SET: Gain 12, normal input
    {0x06, 0b01100000},  // CH2SET: Gain 12, normal input
    {0x07, 0b01100000},  // CH3SET: Gain 12, normal input
    {0x08, 0b01100000},  // CH4SET: Gain 12, normal input
    {0x09, 0b01100000},  // CH5SET: Gain 12, normal input
    {0x0A, 0b01100000},  // CH6SET: Gain 12, normal input
    {0x0B, 0b01100000},  // CH7SET: Gain 12, normal input
    {0x0C, 0b01100000},  // CH8SET: Gain 12, normal input
    {0x0D, 0b11111111},  // BIAS_SENSP: All positive channels for bias
    {0x0E, 0b11111111},  // BIAS_SENSN: All negative channels for bias
    {0x0F, 0},           // LOFF_SENSP: Lead-off sensing disabled
    {0x10, 0},           // LOFF_SENSN: Lead-off sensing disabled
    {0x11, 0},           // LOFF_FLIP: No lead-off current direction flip
    {-2, -2},            // End of second section
    {0x15, 0},           // MISC1: SRB1 disabled
    {0x16, 0},           // MISC2: Reserved
    {0x17, 0},           // CONFIG4: Continuous conversion mode
    {0x02, 0xD0},        // CONFIG2: Test signal settings
    {0x05, 0x05},        // CH1SET: Test signal input
    {0x06, 0x05}         // CH2SET: Test signal input
};

/* This is not an init function that lives in ads1299.c.
   This file is blessed to sift necessary information from main.c to fill the vessels zephyr_dev and spi_cfg*/
int ADS1299_INIT(const struct ads1299_config *config) {
    if (!config || !config->zephyr_spi_dev || !config->spi_cfg) {
        return -EINVAL;
    }
    // No need to store zephyr_dev or spi_cfg, just use config directly
    return 0;
}

/* Internal function to send SPI command */
int ADS1299_SEND_CMD(uint8_t cmd, const struct ads1299_config *config) {
    struct spi_buf tx_buf = {
        .buf = &cmd,
        .len = 1
    };
    struct spi_buf_set tx_bufs = {
        .buffers = &tx_buf,
        .count = 1
    };

    int ret = spi_write(config->zephyr_spi_dev, config->spi_cfg, &tx_bufs);

    if (ret != 0) {
        printk("Failed to send command 0x%02x: %d\n", cmd, ret);
        return ret;
    }

    ads1299_prev_cmd = cmd;
    k_usleep(4 * 1000000 / ADS1299_SPI_FREQ); // Wait 4 tCLK cycles

    return 0;
}

/* Internal function for register operations */
static int ADS1299_REG_OPS(uint8_t opcode, uint8_t reg_addr, uint8_t *data, uint8_t len, const struct ads1299_config *config) {
    uint8_t cmd_buf[2];
    struct spi_buf tx_bufs_arr[3];
    struct spi_buf_set tx_bufs;
    int buf_count = 0;

    // First command byte: opcode + register address
    cmd_buf[0] = opcode | (reg_addr & 0x1F);
    tx_bufs_arr[buf_count].buf = &cmd_buf[0];
    tx_bufs_arr[buf_count].len = 1;
    buf_count++;

    // Second command byte: number of registers - 1
    cmd_buf[1] = len - 1;
    tx_bufs_arr[buf_count].buf = &cmd_buf[1];
    tx_bufs_arr[buf_count].len = 1;
    buf_count++;

    // For write operations, add data
    if ((opcode & 0x60) == 0x40) { // WREG command
        tx_bufs_arr[buf_count].buf = data;
        tx_bufs_arr[buf_count].len = len;
        buf_count++;
    }

    tx_bufs.buffers = tx_bufs_arr;
    tx_bufs.count = buf_count;

    int ret = spi_write(config->zephyr_spi_dev, config->spi_cfg, &tx_bufs);
    if (ret != 0) {
        printk("Failed register operation: %d\n", ret);
        return ret;
    }

    k_usleep(4 * 1000000 / ADS1299_SPI_FREQ); // Wait 4 tCLK cycles

    // For read operations, read the data
    if ((opcode & 0x60) == 0x20) { // RREG command
        struct spi_buf rx_buf = {
            .buf = data,
            .len = len
        };
        struct spi_buf_set rx_bufs = {
            .buffers = &rx_buf,
            .count = 1
        };

        ret = spi_read(config->zephyr_spi_dev, config->spi_cfg, &rx_bufs);
        if (ret != 0) {
            printk("Failed to read register data: %d\n", ret);
            return ret;
        }
    }

    return 0;
}

void ADS1299_WREG(uint8_t reg_addr, uint8_t *data, uint8_t len, const struct ads1299_config *config) {
    if (ads1299_mode == ADS1299_MODE_RDATAC) {
        printk("Warning: Cannot write registers in RDATAC mode\n");
        return;
    }

    ADS1299_REG_OPS(0x40, reg_addr, data, len, config);
    ads1299_prev_cmd = CMD_ADC_WREG;
}

void ADS1299_RREG(uint8_t reg_addr, uint8_t *data, uint8_t len, const struct ads1299_config *config) {
    if (ads1299_mode == ADS1299_MODE_RDATAC) {
        printk("Warning: Cannot read registers in RDATAC mode\n");
        return;
    }

    ADS1299_REG_OPS(0x20, reg_addr, data, len, config);
    ads1299_prev_cmd = CMD_ADC_RREG;
}

void ADS1299_SDATAC(const struct ads1299_config *config) {
    ADS1299_SEND_CMD(CMD_ADC_SDATAC, config);
    ads1299_mode = ADS1299_MODE_SDATAC;
    printk("ADS1299 set to SDATAC mode\n");
}

void ADS1299_RDATAC(const struct ads1299_config *config) {
    ADS1299_SEND_CMD(CMD_ADC_RDATAC, config);
    ads1299_mode = ADS1299_MODE_RDATAC;
    printk("ADS1299 set to RDATAC mode\n");
}

void ADS1299_START(const struct ads1299_config *config) {
    ADS1299_SEND_CMD(CMD_ADC_START, config);
    printk("ADS1299 START command sent\n");
}

void ADS1299_RESET(const struct ads1299_config *config) {
    ADS1299_SEND_CMD(0x06, config); // RESET command
    k_msleep(18 * 1000000 / ADS1299_SPI_FREQ); // Wait 18 tCLK cycles
    ads1299_mode = -2;
    printk("ADS1299 RESET command sent\n");
}

void ADS1299_WAKEUP(const struct ads1299_config *config) {
    ADS1299_SEND_CMD(0x02, config); // WAKEUP command
    printk("ADS1299 WAKEUP command sent\n");
}

void ADS1299_STANDBY(const struct ads1299_config *config) {
    ADS1299_SEND_CMD(0x04, config); // STANDBY command
    printk("ADS1299 STANDBY command sent\n");
}

int ADS1299_SETUP(const struct ads1299_config *config) {
    int ret;
    uint8_t reg_val;

    printk("Configuring ADS1299 registers...\n");

    // Make sure we're in SDATAC mode
    if (ads1299_mode != ADS1299_MODE_SDATAC) {
        ADS1299_SDATAC(config);
        k_msleep(1);
    }

    // Configure registers according to the register list
    for (int i = 0; i < ARRAY_SIZE(ADS1299_REGISTER_LS); i++) {
        const regVal_pair reg_pair = ADS1299_REGISTER_LS[i];

        // Check for end marker
        if (reg_pair.add == -2) {
            printk("Register configuration section %d complete\n", i);
            k_msleep(1); // Small delay between sections
            continue;
        }

        reg_val = (uint8_t)reg_pair.reg_val;
        ADS1299_WREG(reg_pair.add, &reg_val, 1, config);

        // Verify the write by reading back
        uint8_t readback_val = 0;
        ADS1299_RREG(reg_pair.add, &readback_val, 1, config);

        if (readback_val != reg_val) {
            printk("Register 0x%02x verification failed: wrote 0x%02x, read 0x%02x\n",
                   reg_pair.add, reg_val, readback_val);
            // Continue with other registers - don't fail completely
        } else {
            printk("Register 0x%02x = 0x%02x OK\n", reg_pair.add, reg_val);
        }

        k_msleep(1);
    }

    printk("ADS1299 register configuration complete\n");
    return 0;
}

// Function to read ADS1299 ID register for verification
int ADS1299_READ_ID(uint8_t *id_val, const struct ads1299_config *config) {
    if (ads1299_mode == ADS1299_MODE_RDATAC) {
        ADS1299_SDATAC(config);
        k_msleep(1);
    }

    ADS1299_RREG(0x00, id_val, 1, config); // ID register is at address 0x00

    printk("ADS1299 ID register: 0x%02x\n", *id_val);

    // Decode ID register
    uint8_t rev_id = (*id_val >> 5) & 0x7;
    uint8_t dev_id = (*id_val >> 2) & 0x3;
    uint8_t nu_ch = *id_val & 0x3;

    printk("  Revision ID: %d\n", rev_id);
    printk("  Device ID: %d\n", dev_id);
    printk("  Number of channels: %d\n", (nu_ch == 0) ? 4 : (nu_ch == 1) ? 6 : 8);

    return 0;
}
```

## src/ads1299.h
```c
#ifndef ADS1299_H
#define ADS1299_H

// Minimum necessary libraries
#include <stdint.h>
#include <zephyr/sys/util.h>

// Define the SPI frequency
#define ADS1299_SPI_FREQ 4000000

// --- Pin Mapping ---
static const uint8_t pin_MOSI_NUM = 23;
static const uint8_t pin_CS_NUM = 5;
static const uint8_t pin_MISO_NUM = 19;
static const uint8_t pin_SCK_NUM = 18;
static const uint8_t pin_PWDN_NUM = 13;
static const uint8_t pin_RST_NUM = 12;
static const uint8_t pin_START_NUM = 14;
static const uint8_t pin_DRDY_NUM = 27;
static const uint8_t pin_LED_DEBUG = 17;

// ADS1299 State Management
#define ADS1299_MODE_SDATAC 1
#define ADS1299_MODE_RDATAC 2

#define CMD_ADC_WREG 3
#define CMD_ADC_RREG 4
#define CMD_ADC_SDATAC 0x11
#define CMD_ADC_RDATAC 0x10
#define CMD_ADC_START  0x08

/* Current ADS1299 state */
static int ads1299_mode = -2; // init states before being manipulated
static int ads1299_prev_cmd = -1;

/* Unit Data Structure for controlling registers */
typedef struct {
    int add;
    int reg_val;
} regVal_pair;

/* List of registers to be set. If -2, end WREG. */
extern const regVal_pair ADS1299_REGISTER_LS[];

// Function declarations
struct ads1299_config {
    const struct device *zephyr_spi_dev;
    const struct spi_config *spi_cfg;
};

void ADS1299_WREG(uint8_t reg_addr, uint8_t *data, uint8_t len, const struct ads1299_config *config);
void ADS1299_RREG(uint8_t reg_addr, uint8_t *data, uint8_t len, const struct ads1299_config *config);
void ADS1299_SDATAC(const struct ads1299_config *config);
void ADS1299_RDATAC(const struct ads1299_config *config);
void ADS1299_START(const struct ads1299_config *config);
void ADS1299_RESET(const struct ads1299_config *config);
void ADS1299_WAKEUP(const struct ads1299_config *config);
void ADS1299_STANDBY(const struct ads1299_config *config);
int ADS1299_SETUP(const struct ads1299_config *config);
int ADS1299_READ_ID(uint8_t *id_val, const struct ads1299_config *config);
int ADS1299_SEND_CMD(uint8_t cmd, const struct ads1299_config *config);
int ADS1299_INIT(const struct ads1299_config *config);
static int ADS1299_REG_OPS(uint8_t opcode, uint8_t reg_addr, uint8_t *data, uint8_t len, const struct ads1299_config *config);

#endif // ADS1299_H
```

## src/data_handler.c
```c
#include "data_handler.h"
#include <zephyr/sys/printk.h>
#include <zephyr/timing/timing.h>
#include <string.h>

// Static variables
static uint32_t sample_counter = 0;
static timing_t start_time;

// CRC-16 lookup table (CRC-16-CCITT)
static const uint16_t crc16_table[256] = {
    0x0000, 0x1021, 0x2042, 0x3063, 0x4084, 0x50A5, 0x60C6, 0x70E7,
    0x8108, 0x9129, 0xA14A, 0xB16B, 0xC18C, 0xD1AD, 0xE1CE, 0xF1EF,
    0x1231, 0x0210, 0x3273, 0x2252, 0x52B5, 0x4294, 0x72F7, 0x62D6,
    0x9339, 0x8318, 0xB37B, 0xA35A, 0xD3BD, 0xC39C, 0xF3FF, 0xE3DE,
    0x2462, 0x3443, 0x0420, 0x1401, 0x64E6, 0x74C7, 0x44A4, 0x5485,
    0xA56A, 0xB54B, 0x8528, 0x9509, 0xE5EE, 0xF5CF, 0xC5AC, 0xD58D,
    0x3653, 0x2672, 0x1611, 0x0630, 0x76D7, 0x66F6, 0x5695, 0x46B4,
    0xB75B, 0xA77A, 0x9719, 0x8738, 0xF7DF, 0xE7FE, 0xD79D, 0xC7BC,
    0x48C4, 0x58E5, 0x6886, 0x78A7, 0x0840, 0x1861, 0x2802, 0x3823,
    0xC9CC, 0xD9ED, 0xE98E, 0xF9AF, 0x8948, 0x9969, 0xA90A, 0xB92B,
    0x5AF5, 0x4AD4, 0x7AB7, 0x6A96, 0x1A71, 0x0A50, 0x3A33, 0x2A12,
    0xDBFD, 0xCBDC, 0xFBBF, 0xEB9E, 0x9B79, 0x8B58, 0xBB3B, 0xAB1A,
    0x6CA6, 0x7C87, 0x4CE4, 0x5CC5, 0x2C22, 0x3C03, 0x0C60, 0x1C41,
    0xEDAE, 0xFD8F, 0xCDEC, 0xDDCD, 0xAD2A, 0xBD0B, 0x8D68, 0x9D49,
    0x7E97, 0x6EB6, 0x5ED5, 0x4EF4, 0x3E13, 0x2E32, 0x1E51, 0x0E70,
    0xFF9F, 0xEFBE, 0xDFDD, 0xCFFC, 0xBF1B, 0xAF3A, 0x9F59, 0x8F78,
    0x9188, 0x81A9, 0xB1CA, 0xA1EB, 0xD10C, 0xC12D, 0xF14E, 0xE16F,
    0x1080, 0x00A1, 0x30C2, 0x20E3, 0x5004, 0x4025, 0x7046, 0x6067,
    0x83B9, 0x9398, 0xA3FB, 0xB3DA, 0xC33D, 0xD31C, 0xE37F, 0xF35E,
    0x02B1, 0x1290, 0x22F3, 0x32D2, 0x4235, 0x5214, 0x6277, 0x7256,
    0xB5EA, 0xA5CB, 0x95A8, 0x8589, 0xF56E, 0xE54F, 0xD52C, 0xC50D,
    0x34E2, 0x24C3, 0x14A0, 0x0481, 0x7466, 0x6447, 0x5424, 0x4405,
    0xA7DB, 0xB7FA, 0x8799, 0x97B8, 0xE75F, 0xF77E, 0xC71D, 0xD73C,
    0x26D3, 0x36F2, 0x0691, 0x16B0, 0x6657, 0x7676, 0x4615, 0x5634,
    0xD94C, 0xC96D, 0xF90E, 0xE92F, 0x99C8, 0x89E9, 0xB98A, 0xA9AB,
    0x5844, 0x4865, 0x7806, 0x6827, 0x18C0, 0x08E1, 0x3882, 0x28A3,
    0xCB7D, 0xDB5C, 0xEB3F, 0xFB1E, 0x8BF9, 0x9BD8, 0xABBB, 0xBB9A,
    0x4A75, 0x5A54, 0x6A37, 0x7A16, 0x0AF1, 0x1AD0, 0x2AB3, 0x3A92,
    0xFD2E, 0xED0F, 0xDD6C, 0xCD4D, 0xBDAA, 0xAD8B, 0x9DE8, 0x8DC9,
    0x7C26, 0x6C07, 0x5C64, 0x4C45, 0x3CA2, 0x2C83, 0x1CE0, 0x0CC1,
    0xEF1F, 0xFF3E, 0xCF5D, 0xDF7C, 0xAF9B, 0xBFBA, 0x8FD9, 0x9FF8,
    0x6E17, 0x7E36, 0x4E55, 0x5E74, 0x2E93, 0x3EB2, 0x0ED1, 0x1EF0
};

void init_data_handler(void) {
    timing_init();
    start_time = timing_counter_get();
    sample_counter = 0;
    printk("Data handler initialized\n");
}

uint64_t get_timestamp_us(void) {
    timing_t current_time = timing_counter_get();
    uint64_t cycles = timing_cycles_get(&start_time, &current_time);
    return timing_cycles_to_ns(cycles) / 1000; // Convert to microseconds
}

uint16_t calculate_crc16(const uint8_t *data, size_t length) {
    uint16_t crc = 0xFFFF;
    
    for (size_t i = 0; i < length; i++) {
        crc = (crc << 8) ^ crc16_table[((crc >> 8) ^ data[i]) & 0xFF];
    }
    
    return crc;
}

int32_t convert_24bit_to_32bit(const uint8_t *data) {
    // Convert 24-bit two's complement to 32-bit signed integer
    int32_t result = (data[0] << 24) | (data[1] << 16) | (data[2] << 8);
    return result >> 8; // Sign extend by shifting right
}

void process_ads1299_data(const uint8_t *raw_data, ads1299_sample_t *sample) {
    if (!raw_data || !sample) {
        printk("Invalid parameters in process_ads1299_data\n");
        return;
    }
    
    // Get timestamp first
    sample->timestamp_us = (uint32_t)get_timestamp_us();
    sample->sample_number = ++sample_counter;
    
    // Extract 24-bit status (first 3 bytes)
    sample->status = (raw_data[0] << 16) | (raw_data[1] << 8) | raw_data[2];
    
    // Parse status bits according to ADS1299 datasheet
    // Status format: 1100 + LOFF_STATP + LOFF_STATN + GPIO[4:7]
    sample->lead_off_status_p = (raw_data[1] >> 4) & 0x0F; // LOFF_STATP
    sample->lead_off_status_n = raw_data[1] & 0x0F;        // LOFF_STATN
    sample->gpio_status = raw_data[2] & 0x0F;              // GPIO[4:7]
    
    // Extract channel data (24-bit each, starting from byte 3)
    for (int ch = 0; ch < ADS1299_NUM_CHANNELS; ch++) {
        int offset = ADS1299_STATUS_BYTES + (ch * ADS1299_BYTES_PER_CHANNEL);
        sample->channels[ch] = convert_24bit_to_32bit(&raw_data[offset]);
    }
}

size_t format_sample_for_transmission(const ads1299_sample_t *sample, uint8_t *buffer, size_t buffer_size) {
    if (!sample || !buffer) {
        return 0;
    }
    
    // Calculate required buffer size
    size_t required_size = sizeof(ads1299_packet_t);
    if (buffer_size < required_size) {
        printk("Buffer too small: need %zu, have %zu\n", required_size, buffer_size);
        return 0;
    }
    
    ads1299_packet_t *packet = (ads1299_packet_t *)buffer;
    
    // Fill packet header
    packet->start_bytes[0] = PACKET_START_BYTE1;
    packet->start_bytes[1] = PACKET_START_BYTE2;
    packet->packet_type = PACKET_TYPE_ADS1299;
    packet->payload_length = sizeof(ads1299_sample_t) + sizeof(uint64_t); // sample + timestamp
    
    // Add timestamp
    packet->timestamp_us = get_timestamp_us();
    
    // Copy sample data
    memcpy(&packet->sample, sample, sizeof(ads1299_sample_t));
    
    // Calculate CRC over header + timestamp + sample data
    size_t crc_data_size = PACKET_HEADER_SIZE + PACKET_TIMESTAMP_SIZE + sizeof(ads1299_sample_t);
    packet->crc16 = calculate_crc16((uint8_t *)packet, crc_data_size);
    
    // Fill packet trailer
    packet->end_bytes[0] = PACKET_END_BYTE1;
    packet->end_bytes[1] = PACKET_END_BYTE2;
    
    return required_size;
}

bool validate_packet(const ads1299_packet_t *packet) {
    if (!packet) {
        return false;
    }
    
    // Check start bytes
    if (packet->start_bytes[0] != PACKET_START_BYTE1 || 
        packet->start_bytes[1] != PACKET_START_BYTE2) {
        return false;
    }
    
    // Check end bytes
    if (packet->end_bytes[0] != PACKET_END_BYTE1 || 
        packet->end_bytes[1] != PACKET_END_BYTE2) {
        return false;
    }
    
    // Check packet type
    if (packet->packet_type != PACKET_TYPE_ADS1299) {
        return false;
    }
    
    // Verify CRC
    size_t crc_data_size = PACKET_HEADER_SIZE + PACKET_TIMESTAMP_SIZE + sizeof(ads1299_sample_t);
    uint16_t calculated_crc = calculate_crc16((uint8_t *)packet, crc_data_size);
    
    if (calculated_crc != packet->crc16) {
        printk("CRC mismatch: calculated 0x%04x, packet 0x%04x\n", 
               calculated_crc, packet->crc16);
        return false;
    }
    
    return true;
}

// Debug function to print sample data
void print_sample_debug(const ads1299_sample_t *sample) {
    if (!sample) {
        return;
    }
    
    printk("Sample #%u @ %u us:\n", sample->sample_number, sample->timestamp_us);
    printk("  Status: 0x%06x, LOFF_P: 0x%02x, LOFF_N: 0x%02x, GPIO: 0x%02x\n", 
           sample->status, sample->lead_off_status_p, 
           sample->lead_off_status_n, sample->gpio_status);
    
    for (int ch = 0; ch < ADS1299_NUM_CHANNELS; ch++) {
        printk("  CH%d: %d (0x%08x)\n", ch + 1, sample->channels[ch], 
               (uint32_t)sample->channels[ch]);
    }
}
```

## src/data_handler.h
```c
#ifndef DATA_HANDLER_H
#define DATA_HANDLER_H

#include <stdint.h>
#include <zephyr/kernel.h>

// ADS1299 data constants
#define ADS1299_NUM_CHANNELS    8
#define ADS1299_BYTES_PER_CHANNEL   3  // 24-bit data
#define ADS1299_STATUS_BYTES    3      // 24-bit status
#define ADS1299_TOTAL_DATA_BYTES    (ADS1299_STATUS_BYTES + (ADS1299_NUM_CHANNELS * ADS1299_BYTES_PER_CHANNEL))

// Packet format constants
#define PACKET_HEADER_SIZE      4
#define PACKET_TIMESTAMP_SIZE   8
#define PACKET_CRC_SIZE         2
#define PACKET_TRAILER_SIZE     2
#define PACKET_OVERHEAD         (PACKET_HEADER_SIZE + PACKET_TIMESTAMP_SIZE + PACKET_CRC_SIZE + PACKET_TRAILER_SIZE)

// Packet identifiers
#define PACKET_START_BYTE1      0xAA
#define PACKET_START_BYTE2      0x55
#define PACKET_TYPE_ADS1299     0x01
#define PACKET_END_BYTE1        0x55
#define PACKET_END_BYTE2        0xAA

// Data structures
typedef struct {
    uint32_t timestamp_us;      // Microsecond timestamp
    uint32_t sample_number;     // Incremental sample counter
    uint32_t status;            // 24-bit status register
    int32_t channels[ADS1299_NUM_CHANNELS]; // Channel data (sign-extended from 24-bit)
    uint8_t lead_off_status_p;  // Lead-off status positive
    uint8_t lead_off_status_n;  // Lead-off status negative
    uint8_t gpio_status;        // GPIO status
} ads1299_sample_t;

typedef struct {
    uint8_t start_bytes[2];     // 0xAA, 0x55
    uint8_t packet_type;        // 0x01 for ADS1299
    uint8_t payload_length;     // Length of payload
    uint64_t timestamp_us;      // 8-byte timestamp
    ads1299_sample_t sample;    // ADS1299 sample data
    uint16_t crc16;             // CRC-16 checksum
    uint8_t end_bytes[2];       // 0x55, 0xAA
} __attribute__((packed)) ads1299_packet_t;

// Function declarations
void process_ads1299_data(const uint8_t *raw_data, ads1299_sample_t *sample);
size_t format_sample_for_transmission(const ads1299_sample_t *sample, 
                                      uint8_t *buffer, size_t buffer_size);
uint16_t calculate_crc16(const uint8_t *data, size_t length);
int32_t convert_24bit_to_32bit(const uint8_t *data);
uint64_t get_timestamp_us(void);

// Data integrity functions
bool validate_packet(const ads1299_packet_t *packet);
void init_data_handler(void);

#endif // DATA_HANDLER_H
```
